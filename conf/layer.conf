## conf/layer.conf
```bitbake
BBPATH .= ":${LAYERDIR}"

BBFILES += "${LAYERDIR}/recipes*/*/*.bb ${LAYERDIR}/recipes*/*/*.bbappend"

BBFILE_COLLECTIONS += "meta-unit-networking"
BBFILE_PATTERN_meta-unit-networking := "^${LAYERDIR}/"
BBFILE_PRIORITY_meta-unit-networking = "13"

LAYERDEPENDS_meta-unit-networking = "core openembedded-layer networking-layer"

LAYERSERIES_COMPAT_meta-unit-networking = "whinlatter"

UNIT_NETWORKING_LAYERDIR = "${LAYERDIR}"

BBFILES_DYNAMIC += " \
    freescale-layer:${LAYERDIR}/dynamic-layers/freescale-layer/*/*/*.bb \
    freescale-layer:${LAYERDIR}/dynamic-layers/freescale-layer/*/*/*.bbappend \
    raspberrypi:${LAYERDIR}/dynamic-layers/raspberrypi/*/*/*.bb \
    raspberrypi:${LAYERDIR}/dynamic-layers/raspberrypi/*/*/*.bbappend \
    sunxi:${LAYERDIR}/dynamic-layers/sunxi/*/*/*.bb \
    sunxi:${LAYERDIR}/dynamic-layers/sunxi/*/*/*.bbappend \
"
```
